## modules/azoteq/dts/bindings/behaviors/zmk,behavior-force-adjust.yaml
```yaml
description: One fixed force threshold command for graphical keymap editors
compatible: "zmk,behavior-force-adjust"
include: zero_param.yaml
properties:
  command:
    type: int
    required: true
    enum: [0, 1, 2, 3, 4, 5]
  amount:
    type: int
    default: 100
```

## modules/azoteq/dts/bindings/behaviors/zmk,behavior-force-config.yaml
```yaml
description: Fixed touchpad strength threshold adjustment
compatible: "zmk,behavior-force-config"
include: two_param.yaml
```

## modules/azoteq/dts/bindings/toucan,touch-guard.yaml
```yaml
description: Recover the automatic touch layer when touch or split reports stop
compatible: "toucan,touch-guard"
include: base.yaml
properties:
  device:
    type: phandle
    required: true
  layer:
    type: int
    required: true
  timeout-ms:
    type: int
    default: 750
```
